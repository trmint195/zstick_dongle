#include <behaviors.dtsi>
#include <dt-bindings/zmk/keys.h>

/ {
    keymap {
        compatible = "zmk,keymap";
        display-name = "ZStick Keymap";
        label = "ZStick Keymap";
        default_layer {
            bindings = <
                &bootloader
            >;
        };
    };
};

## boards/arm/zstick/Kconfig
```kconfig
# SPDX-License-Identifier: MIT

config BOARD_ENABLE_DCDC_HV
    bool "High voltage DCDC converter"
    select SOC_DCDC_NRF52X_HV
    default y
    depends on (BOARD_ZSTICK)
    
config BOARD_ENABLE_DCDC
    bool "Low voltage DCDC converter"
    select SOC_DCDC_NRF52X
    default n
    depends on (BOARD_ZSTICK)
```

## boards/arm/zstick/Kconfig.board
```kconfig
# Copyright (c) 2022 The ZMK Contributors
# SPDX-License-Identifier: MIT

config BOARD_ZSTICK
    bool "zstick"
    depends on SOC_NRF52840_QIAA
```

## boards/arm/zstick/Kconfig.defconfig
```kconfig
# Copyright (c) 2022 The ZMK Contributors
# SPDX-License-Identifier: MIT

if BOARD_ZSTICK

config BOARD
    default "zstick"
    
config BUILD_OUTPUT_UF2_FAMILY_ID
	default "0x621e937a"

if USB_DEVICE_STACK

config USB_NRFX
    default y

endif # USB_DEVICE_STACK

config BT_CTLR
    default BT

endif # BOARD_ZSTICK
```
